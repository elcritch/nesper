## esp-idf-examples/net_pppos_usb/sdkconfig.defaults.ncm
```kconfig
# NCM-as-Ethernet + one CDC for console
CONFIG_IDF_TARGET="esp32s3"
CONFIG_APP_NO_BLOBS=y
CONFIG_ESPTOOLPY_FLASHMODE_QIO=y
CONFIG_ESPTOOLPY_FLASHSIZE_8MB=y
CONFIG_PARTITION_TABLE_CUSTOM=y
CONFIG_USJ_ENABLE_USB_SERIAL_JTAG=n
CONFIG_ESP_CONSOLE_SECONDARY_NONE=y

# Disable PPP
# CONFIG_LWIP_PPP_SUPPORT is not set
CONFIG_LWIP_MULTICAST_PING=y
CONFIG_LWIP_BROADCAST_PING=y

# TinyUSB
CONFIG_TINYUSB_DEBUG_LEVEL=02
CONFIG_TINYUSB_CDC_ENABLED=y
CONFIG_TINYUSB_CDC_COUNT=1
CONFIG_TINYUSB_NET_MODE_NCM=y
```
